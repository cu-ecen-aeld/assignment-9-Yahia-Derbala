## base_external/package/aesdchar/Config.in
```kconfig
config BR2_PACKAGE_AESDCHAR
    bool "aesdchar"
    help
      Enable support for AESDCHAR modules in the root filesystem.
```

## base_external/package/ldd/Config.in
```kconfig
config BR2_PACKAGE_LDD
    bool "ldd"
    help
      Enable support for ldd modules in the root filesystem.
```
